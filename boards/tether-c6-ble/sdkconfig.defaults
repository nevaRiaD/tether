## boards/tether-c6-ble/sdkconfig.defaults
```kconfig
CONFIG_BT_ENABLED=y
CONFIG_BT_NIMBLE_ENABLED=y
CONFIG_BT_NIMBLE_HCI_EVT_BUF_SIZE=70
CONFIG_BT_NIMBLE_EXT_ADV=y
CONFIG_BT_NIMBLE_MAX_CONNECTIONS=30
CONFIG_BT_NIMBLE_GATT_MAX_PROCS=70
CONFIG_BT_NIMBLE_MSYS_1_BLOCK_COUNT=100
CONFIG_BT_NIMBLE_OPTIMIZE_MULTI_CONN=y
CONFIG_BT_NIMBLE_LOG_LEVEL_WARNING=y
CONFIG_BT_NIMBLE_BLE_POWER_CONTROL=y

# for irk bonding to store stable identity
CONFIG_BT_NIMBLE_NVS_PERSIST=y

# Bond capacity: phones + tags share these slots.
# RESOLV_LIST_SIZE is the controller's HW resolving list and is hardware-capped
# at 5 on the C6 (Kconfig `range 1 5`) — it CANNOT track MAX_BONDS=10. We set it
# to the max (5). Bonds beyond the list still work via host-side RPA resolution
# from NVS; only controller-side HW resolution is unavailable for the overflow.
# If >5 RPA peers (iPhones) bond, the surplus log "failed to configure restored
# IRK" at sync — non-fatal. Tags use public/static addresses, so they don't rely
# on the resolving list.
CONFIG_BT_NIMBLE_MAX_BONDS=10
CONFIG_BT_NIMBLE_MAX_CCCDS=20
CONFIG_BT_LE_LL_RESOLV_LIST_SIZE=5

# Primary console on UART0 so REPL reads from /dev/ttyUSB0 (CP2102 bridge)
CONFIG_ESP_CONSOLE_UART_DEFAULT=y
# CONFIG_ESP_CONSOLE_USB_SERIAL_JTAG is not set
CONFIG_ESP_CONSOLE_SECONDARY_NONE=y
# CONFIG_ESP_CONSOLE_SECONDARY_USB_SERIAL_JTAG is not set
```

## boards/tether-p4-main/sdkconfig.defaults
```kconfig
# Support early ESP32-P4 silicon (chip is rev v1.3)
CONFIG_ESP32P4_SELECTS_REV_LESS_V3=y
CONFIG_ESP32P4_REV_MIN_100=y

# Use USB-Serial-JTAG as the primary console (single-cable flash + log + REPL)
CONFIG_ESP_CONSOLE_USB_SERIAL_JTAG=y

# System
CONFIG_SOC_PM_FPU_RETENTION_BY_SW=y

# Flash
CONFIG_ESPTOOLPY_FLASHMODE_QIO=y
CONFIG_ESPTOOLPY_FLASHSIZE_32MB=y
CONFIG_ESPTOOLPY_FLASHSIZE="32MB"

# Partition table
CONFIG_PARTITION_TABLE_CUSTOM=y
CONFIG_PARTITION_TABLE_CUSTOM_FILENAME="partitions.csv"

# SPIRAM (required for display frame buffer)
CONFIG_SPIRAM=y
CONFIG_IDF_EXPERIMENTAL_FEATURES=y
CONFIG_SPIRAM_SPEED_200M=y
CONFIG_SPIRAM_XIP_FROM_PSRAM=y
CONFIG_CACHE_L2_CACHE_256KB=y
CONFIG_CACHE_L2_CACHE_LINE_128B=y

# BSP LCD / display settings
CONFIG_BSP_LCD_DPI_BUFFER_NUMS=1
CONFIG_BSP_DISPLAY_BRIGHTNESS_LEDC_CH=1
CONFIG_BSP_LCD_COLOR_FORMAT_RGB565=y

# FreeRTOS
CONFIG_FREERTOS_HZ=1000
CONFIG_ESP_MAIN_TASK_STACK_SIZE=10240

# Compiler optimization
CONFIG_COMPILER_OPTIMIZATION_PERF=y

# LVGL — hot render functions in IRAM to avoid PSRAM bandwidth contention with DPI DMA
CONFIG_LV_OS_FREERTOS=y
CONFIG_LV_DEF_REFR_PERIOD=15
CONFIG_LV_DRAW_SW_DRAW_UNIT_CNT=2
CONFIG_LV_ATTRIBUTE_FAST_MEM_USE_IRAM=y
CONFIG_LV_USE_CLIB_MALLOC=y
CONFIG_LV_USE_CLIB_STRING=y
CONFIG_LV_USE_CLIB_SPRINTF=y
CONFIG_LV_FONT_MONTSERRAT_12=y
CONFIG_LV_FONT_MONTSERRAT_16=y
CONFIG_LV_FONT_MONTSERRAT_18=y
CONFIG_LV_FONT_MONTSERRAT_20=y
CONFIG_LV_FONT_MONTSERRAT_22=y
CONFIG_LV_FONT_MONTSERRAT_24=y
CONFIG_LV_FONT_MONTSERRAT_26=y
CONFIG_LV_USE_FONT_COMPRESSED=y
CONFIG_LV_TXT_BREAK_CHARS=" ,.;:-_"
CONFIG_LV_USE_IMGFONT=y
CONFIG_LV_USE_GIF=y
```
